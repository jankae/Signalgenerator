#include "Charger.h"
#include "gui.h"
#include "pushpull.h"

static const uint16_t imagedata[1024] = {
		0x0000,0x0000,0x0000,0x0000,0x0000,0x0000,0x0000,0x0000,0x0000,0x0000,0x0000,0x0000,0x0000,0x0000,0x0000,0x0000,0x0000,0x0000,0x0000,0x0000,0x0000,0x0000,0x0000,0x0000,0x0000,0x0000,0x0000,0x0000,0x0000,0x0000,0x0000,0x0000,
		0x0000,0x0000,0x0000,0x0000,0x0000,0x0000,0x0000,0x0000,0x0000,0x0000,0x0000,0x0000,0x0000,0x0000,0x0000,0x0000,0x0000,0x0020,0x2965,0x528a,0x6b6d,0x7bcf,0x7bcf,0x528a,0x0000,0x0000,0x0000,0x0000,0x0000,0x0000,0x0000,0x0000,
		0x0000,0x0000,0x0000,0x0000,0x0000,0x0000,0x0000,0x0000,0x0000,0x0000,0x0000,0x1020,0x1840,0x0000,0x0000,0x0000,0x0000,0x0841,0x39c7,0x5acb,0x8410,0x94b2,0x94b2,0x6b4d,0x0841,0x0000,0x0000,0x0000,0x0000,0x0000,0x0000,0x0000,
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		0x0000,0x0000,0x0000,0x0000,0x0000,0x0000,0x0000,0x0000,0x0000,0x0000,0x0000,0x0000,0x0000,0x0000,0x0000,0x0000,0x0000,0x0000,0x0000,0x0000,0x0000,0x0000,0x0000,0x0000,0x0000,0x0000,0x0000,0x0000,0x0000,0x0000,0x0000,0x0000,
};

static Image_t icon = { .width = 32, .height = 32, .data = imagedata };

/* Forward declaration of actual app task */
static void Charger(void *unused);

/* Creates the app task, called from desktop when user start the app */
static void Charger_Start(){
	xTaskCreate(Charger, "Charger", 300, NULL, 3, NULL);
}

/* Register this app */
void Charger_Init() {
	App_Register("Charger", "Charge/discharge different batteries", Charger_Start, icon);
}

const char modeNames[2][12] = {"Charging", "Discharging"};
const char *modes[3] = { modeNames[0], modeNames[1], NULL };

#define MODE_CHARGING			0
#define MODE_DISCHARGING		1

const char batteryNames[3][5] = {"PB", "LiPo", "LiIo"};
const char *batteries[4] = { batteryNames[0], batteryNames[1], batteryNames[2], NULL };

#define BATTERY_PB				0
#define BATTERY_LIPO			1
#define BATTERY_LIIO			2
#define BATTERY_NUM				3

const uint32_t maxCellVoltage[BATTERY_NUM] = {
		2300000, /* PB */
		4200000, /* LiPo */
		4200000, /* LiIo */
};
const uint32_t minCellVoltage[BATTERY_NUM] = {
		1750000, /* PB */
		3300000, /* LiPo */
		2500000, /* LiIo */
};

const int32_t minChargeCurrent = 20000;

/* main app widgets */
static ItemChooser *iMode;
static ItemChooser *iBattery;
static Checkbox *cAuto;
static Entry *eCells;
static Button *bStart;

/* Charge window widgets */
static Button *bStop;
static Window *chargeWindow;
static SevenSegment *sVol;
static SevenSegment *sCur;
static Entry *eEnergy;
static Entry *eTime;

static uint8_t active = 0;
static uint32_t activeSince, activeFor, lastUpdate;
static uint8_t mode = 0, battery = 0;
static int32_t cells = 1, minCells = 1, maxCells = 8;
static uint32_t voltageLimit = 2300000;
static int32_t current = 500000;
static bool autoEndVol = 1;
static int32_t transferredEnergy;
static int64_t residualEnergy;
static int32_t batVoltage, batCurrent;

#define MODE_CHANGED		0x01
#define TYPE_CHANGED		0x02
#define AUTO_CHANGED		0x04
#define CELLS_CHANGED		0x08
#define START_CHARGING		0x10
#define STOP_CHARGING		0x20
static uint8_t userInputFlags = 0;

static TaskHandle_t handle;

static void UserInput(Widget &w) {
	if (&w == (Widget*) iMode) {
		userInputFlags |= MODE_CHANGED;
	} else if (&w == (Widget*) iBattery) {
		userInputFlags |= TYPE_CHANGED;
	} else if (&w == (Widget*) eCells) {
		userInputFlags |= CELLS_CHANGED;
	} else if (&w == (Widget*) cAuto) {
		userInputFlags |= AUTO_CHANGED;
	} else if (&w == (Widget*) bStart) {
		userInputFlags |= START_CHARGING;
	} else if (&w == (Widget*) bStop) {
		userInputFlags |= STOP_CHARGING;
	}
	xTaskNotify(handle, SIGNAL_WAKEUP, eSetBits);
}

static void StartCharging(void) {
	/* Check battery voltage */
	if (mode == MODE_CHARGING) {
		/* charging */
		if (pushpull_GetBatteryVoltage() > voltageLimit) {
			Dialog::MessageBox("ERROR", Font_Big,
					"Battery already\nabove maximum\nvoltage", Dialog::MsgBox::OK, NULL, true);
			return;
		}
		if (pushpull_GetBatteryVoltage()
				< cells * minCellVoltage[battery] / 2) {
			Dialog::MessageBox("ERROR", Font_Big,
					"No battery or\ndeeply discharged", Dialog::MsgBox::OK, NULL, true);
			return;
		}
	} else {
		/* discharging */
		if (pushpull_GetBatteryVoltage() < voltageLimit) {
			Dialog::MessageBox("ERROR", Font_Big,
					"No battery or\nalready discharged", Dialog::MsgBox::OK, NULL, true);
			return;
		}
		/* charging */
		if (pushpull_GetBatteryVoltage()
				> cells * (maxCellVoltage[battery] + 200000)) {
			Dialog::MessageBox("ERROR", Font_Big,
					"Battery voltage too\nhigh. Check settings", Dialog::MsgBox::OK, NULL, true);
			return;
		}
	}
	/* Battery seems to be okay, start charging/discharging */

	/* Create GUI elements */
	sVol = new SevenSegment(&batVoltage, 20, 7, 5, 2, COLOR_DARKGREEN);
	sCur = new SevenSegment(&batCurrent, 20, 7, 5, 3, COLOR_RED);
	batVoltage = 0;
	batCurrent = 0;

	Label *lV = new Label("V", Font_Big);
	lV->setColor(COLOR_DARKGREEN);
	Label *lA = new Label("A", Font_Big);
	lA->setColor(COLOR_RED);

	/* Keep track of transferred energy */
	Label *lEnergy = new Label("Energy:", Font_Big);
	eEnergy = new Entry(&transferredEnergy, NULL, NULL, Font_Big, 8, &Unit_Energy);
	eEnergy->setSelectable(false);
	transferredEnergy = 0;
	residualEnergy = 0;

	/* Keep track of time */
	Label *lTime = new Label("Time:", Font_Big);
	eTime = new Entry((int32_t*) &activeFor, NULL, NULL, Font_Big, 8,
			&Unit_Time);
	eTime->setSelectable(false);
	activeFor = 0;

	bStop = new Button("Abort", Font_Big, UserInput);

	char title[15];
	if(mode == MODE_CHARGING) {
		strncpy(title, "CHARGING...", sizeof(title));
	} else {
		strncpy(title, "DISCHARGING...", sizeof(title));
	}
	chargeWindow = new Window(title, Font_Big, COORDS(195, 200));
	Container *c = new Container(chargeWindow->getAvailableArea());

	/* Attach elements to container */
	c->attach(sVol, COORDS(3, 3));
	c->attach(lV, COORDS(170, 6));

	c->attach(sCur, COORDS(3, 53));
	c->attach(lA, COORDS(170, 56));

	c->attach(lEnergy, COORDS(0, 106));
	c->attach(eEnergy, COORDS(85, 106));

	c->attach(lTime, COORDS(0, 128));
	c->attach(eTime, COORDS(85, 128));

	c->attach(bStop,
			COORDS((c->getSize().x - bStop->getSize().x) / 2, 150));

	chargeWindow->setMainWidget(c);

	/* Indicate beginning of charging process */
	active = 1;
	activeSince = lastUpdate = xTaskGetTickCount();

	/* Set output */
	pushpull_SetDriveCurrent(200);
	if(mode==MODE_CHARGING) {
		pushpull_SetVoltage(voltageLimit);
		pushpull_SetSourceCurrent(current);
		/* allow some sink current in case of offset */
		pushpull_SetSinkCurrent(5000);
	} else {
		/* Set voltage all the way to zero, current is limited */
		pushpull_SetVoltage(0);
		/* allow some source current in case of offset */
		pushpull_SetSourceCurrent(5000);
		pushpull_SetSinkCurrent(current);
	}
	pushpull_SetEnabled(1);
}

static void StopCharging(void) {
	/* Disable output */
	pushpull_SetDefault();

	if(chargeWindow) {
		delete chargeWindow;
	}

	active = 0;
}

static void Charge(void) {
	/* Update status */
	batVoltage = pushpull_GetBatteryVoltage()/10000;
	batCurrent = pushpull_GetCurrent()/1000;
	activeFor = xTaskGetTickCount() - activeSince;
	/* Calculate transferred energy */
	int64_t power = (int64_t) pushpull_GetBatteryVoltage()
			* pushpull_GetCurrent() / 1000000UL;
	uint32_t timediff = xTaskGetTickCount() - lastUpdate;
	lastUpdate += timediff;
	residualEnergy += power * timediff;
	int32_t uWh = residualEnergy / 3600000UL;
	if (uWh) {
		transferredEnergy += uWh;
		residualEnergy -= (int64_t) uWh * 3600000UL;
	}
	/* Update widgets */
	sVol->requestRedraw();
	sCur->requestRedraw();
	eTime->requestRedraw();
	eEnergy->requestRedraw();

	/* Monitor end of charge */
	if(activeFor > 1000) {
		/* Charging started a second ago */
		/* if current or voltage falls below threshold, stop charging */
		if ((pushpull_GetCurrent() < current / 20 && mode == MODE_CHARGING)
				|| (pushpull_GetBatteryVoltage() < voltageLimit
						&& mode == MODE_DISCHARGING)) {
			/* Charging: current has become quite small, stop charging */
			/* Discharging: voltage has passed the voltage limit, stop charging */
			StopCharging();
			/* Display charging result */
			char energy[9];
			common_StringFromValue(energy, 8, transferredEnergy, &Unit_Energy);
			char time[8];
			common_StringFromValue(time, 7, activeFor, &Unit_Time);
			char msg[50];
			snprintf(msg, sizeof(msg), "Transferred %s\nin %s", energy, time);
			Dialog::MessageBox("DONE", Font_Big, msg, Dialog::MsgBox::OK, NULL, true);

		}
	}
}

static void Charger(void *unused) {
	handle = xTaskGetCurrentTaskHandle();
	/* Create GUI elements */
	Container *c= new Container(COORDS(280, 240));
	c->setPosition(COORDS(40, 0));

	Label *lMode = new Label("Mode:", Font_Big);
	Label *lType = new Label("Type:", Font_Big);
	Label *lCells = new Label("Cells:", Font_Big);
	Label *lCurrent = new Label("Max I:", Font_Big);
	Label *lAuto = new Label("Auto:", Font_Big);
	Label *lEndVol = new Label("Limit:", Font_Big);

	/* User input fields */
	iMode = new ItemChooser(modes, &mode, Font_Big, 2, 0);
	iBattery = new ItemChooser(batteries, &battery, Font_Big, 3, 0);
	iMode->setCallback(UserInput);
	iBattery->setCallback(UserInput);

	eCells = new Entry(&cells, &maxCells, &minCells, Font_Big, 2, &Unit_None);
	eCells->setCallback(UserInput);
	Entry *eCurrent = new Entry(&current, &Limits.maxCurrent,
			&minChargeCurrent, Font_Big, 6, &Unit_Current);

	cAuto = new Checkbox(&autoEndVol, UserInput);

	Entry *eEndVol = new Entry((int32_t*) &voltageLimit, &Limits.maxVoltage,
			&null, Font_Big, 6, &Unit_Voltage);
	eEndVol->setSelectable(!autoEndVol);

	bStart = new Button("START", Font_Big, UserInput, 100);

	/* Attach GUI elements to main container */
	c->attach(lMode, COORDS(5, 5));
	c->attach(iMode, COORDS(5, 25));

	c->attach(lType, COORDS(180, 5));
	c->attach(iBattery, COORDS(180, 25));

	c->attach(lCells, COORDS(5, 102));
	c->attach(eCells, COORDS(80, 100));

	c->attach(lCurrent, COORDS(125, 102));
	c->attach(eCurrent, COORDS(200, 100));

	c->attach(lEndVol, COORDS(5, 138));
	c->attach(eEndVol, COORDS(80, 136));

	c->attach(lAuto, COORDS(175, 138));
	c->attach(cAuto, COORDS(235, 130));

	c->attach(bStart, COORDS(90, 210));

	/* Notify desktop of started app */
	desktop_AppStarted(Charger_Start, c);

	active = 0;
	/* Initialize pushpull stage */
	pushpull_AcquireControl();
	pushpull_SetAveraging(300);
	pushpull_SetDriveCurrent(200);
	pushpull_SetEnabled(0);
	pushpull_SetInternalResistance(0);

	while(1) {
		uint32_t signal;
		if (App_Handler(&signal, 300)) {
			/* Handle app signals */
			if(signal & SIGNAL_WAKEUP) {
				/* Check user input */
				if (userInputFlags & (MODE_CHANGED | CELLS_CHANGED|TYPE_CHANGED)) {
					/* update max. number of cells */
					maxCells = MAX_VOLTAGE / maxCellVoltage[battery];
					eCells->requestRedraw();
					/* enable auto voltage limit */
					autoEndVol = 1;
					eEndVol->setSelectable(!autoEndVol);
					cAuto->requestRedrawFull();
					/* clear flag */
					userInputFlags &= ~(MODE_CHANGED | CELLS_CHANGED|TYPE_CHANGED);
				}

				if (userInputFlags & AUTO_CHANGED) {
					eEndVol->setSelectable(!autoEndVol);
					/* clear flag */
					userInputFlags &= ~MODE_CHANGED;
				}

				if (autoEndVol) {
					/* update voltage limit */
					if (mode == MODE_CHARGING) {
						/* charging */
						voltageLimit = maxCellVoltage[battery] * cells;
					} else {
						/* discharging */
						voltageLimit = minCellVoltage[battery] * cells;
					}
					eEndVol->requestRedraw();
				}

				if(userInputFlags & START_CHARGING) {
					StartCharging();
					/* clear flag */
					userInputFlags &= ~START_CHARGING;
				}

				if(userInputFlags & STOP_CHARGING) {
					StopCharging();
					/* clear flag */
					userInputFlags &= ~STOP_CHARGING;
				}
			}
		}

		if(active) {
			Charge();
		}
	}
}





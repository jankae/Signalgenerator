#include "gui.h"
#include "pushpull.h"
#include "Battery.h"
#include "Scope.h"
#include "scopescreen.h"

const uint16_t imagedata[1024] = {
	0x0021,0x0021,0x0021,0x0021,0x0021,0x0021,0x0021,0x0021,0x0021,0x0021,0x0021,0x0021,0x0021,0x0021,0x0021,0x0021,0x0021,0x0021,0x0021,0x0021,0x0021,0x0021,0x0021,0x0021,0x0021,0x0021,0x0021,0x0021,0x0021,0x0021,0x0021,0x0021,
	0x0021,0x0021,0x0021,0x0021,0x0021,0x0021,0x0021,0x0021,0x0021,0x0021,0x0021,0x0021,0x0021,0x0021,0x0021,0x0021,0x0021,0x0021,0x0021,0x0021,0x0021,0x0021,0x0021,0x0021,0x0021,0x0021,0x0021,0x0021,0x0021,0x0021,0x0021,0x0021,
	0x0021,0x0021,0x0021,0x0021,0x0021,0x0021,0x0021,0x0021,0x0021,0x0021,0x0021,0x0021,0x0021,0x0021,0x0021,0x0021,0x0021,0x0021,0x0021,0x0021,0x0021,0x0021,0x0021,0x0021,0x0021,0x0021,0x0021,0x0021,0x0021,0x0021,0x0021,0x0021,
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	0x0021,0x0021,0x0021,0x0021,0x0021,0x0021,0x0021,0x0021,0x0021,0x0021,0x0021,0x0021,0x0021,0x0021,0x0021,0x0021,0x0021,0x0021,0x0021,0x0021,0x0021,0x0021,0x0021,0x0021,0x0021,0x0021,0x0021,0x0021,0x0021,0x0021,0x0021,0x0021,
};

static Image_t icon = { .width = 32, .height = 32, .data = imagedata };

/* Forward declaration of actual app task */
static void Scope(void *unused);

/* Creates the app task, called from desktop when user start the app */
static void Scope_Start(){
	xTaskCreate(Scope, "Scope", 1000, NULL, 3, NULL);
}

/* Register this app */
void Scope_Init() {
	App_Register("Scope", "Monitor current and voltage", Scope_Start, icon);
}

static TaskHandle_t handle;


//static void pushpullCallback(PushPull_State_t *state) {
//	if (sampleCnt < SAMPLES) {
//		vResponse[sampleCnt] = state->voltage;
//		cResponse[sampleCnt] = state->current;
//		sampleCnt++;
//	} else {
//		pushpull_SetCallback(NULL);
//		BaseType_t yield;
//		samplingDone = true;
//		portYIELD_FROM_ISR(yield);
//	}
//}

static int32_t currentScale;
static int32_t currentOffset;
static int32_t voltageScale;
static int32_t voltageOffset;
static int32_t timebase;

static bool running;

static Scopescreen *scope;

static constexpr uint16_t scopeWidth = 280;
static constexpr uint8_t scopeHorDivs = 8;

static void scopeChangeCurrent(Widget&) {
	scope->ChangeLineSetting(0, currentScale, currentOffset);
}

static void scopeChangeVoltage(Widget&) {
	scope->ChangeLineSetting(1, voltageScale, voltageOffset);
}

static void pushpullCallback(PushPull_State_t *state) {
	static uint32_t lastUpdate = 0;
	constexpr uint16_t updatePeriod = 20;
	static int64_t avgCur = 0;
	static uint64_t avgVol = 0;
	static uint32_t sampleCnt = 0;

	static constexpr int16_t horDivSize = scopeWidth / scopeHorDivs;

	avgCur += state->current;
	avgVol += state->voltage;
	sampleCnt++;

	uint32_t usPerPixel = timebase * 1000 / horDivSize;
	static uint32_t usPassed = 0;
	usPassed += 1000;
	if (usPassed >= usPerPixel) {
		int32_t cur = avgCur / sampleCnt;
		int32_t vol = avgVol / sampleCnt;
		avgCur = 0;
		avgVol = 0;
		sampleCnt = 0;
		do {
			scope->AddLineData(0, cur);
			scope->AddLineData(1, vol);
			usPassed -= usPerPixel;
		} while (usPassed >= usPerPixel);
	}

	if (HAL_GetTick() - lastUpdate > updatePeriod) {
		lastUpdate = HAL_GetTick();
		scope->UpdateDisplay();
	}
}

static void onOffChange(Widget&) {
	if (running) {
		pushpull_SetCallback(pushpullCallback);
	} else {
		pushpull_SetCallback(nullptr);
	}
}

static void Scope(void *unused) {
	handle = xTaskGetCurrentTaskHandle();
	/* Create GUI elements */
	Container *c= new Container(COORDS(280, 240));
	c->setPosition(COORDS(40, 0));

	currentScale = 1000000;
	currentOffset = 0;
	voltageScale = 3000000;
	voltageOffset = 0;
	timebase = 1000;
	running = true;

	const int32_t maxCurScale = 2000000;
	const int32_t minCurScale = 1000;
	const int32_t maxVolScale = 5000000;
	const int32_t minVolScale = 1000;
	const int32_t minTimebase = 10;
	const int32_t maxTimebase = 60000;
	const int32_t minCurOffset = -Limits.minCurrent;
	const int32_t minVolOffset = -Limits.maxVoltage;

	Label *lScale = new Label("Scale/Div:", Font_Medium);
	Label *lOffset = new Label("Offset:", Font_Medium);
	Label *lTimebase = new Label("Timebase:", Font_Medium);
	Label *lRunning = new Label("Running:", Font_Medium);

	Entry *eCurrentScale = new Entry(&currentScale, &maxCurScale, &minCurScale,
			Font_Medium, 6, &Unit_Current, COLOR_RED);
	Entry *eCurrentOffset = new Entry(&currentOffset, &Limits.maxCurrent, &minCurOffset,
			Font_Medium, 6, &Unit_Current, COLOR_RED);
	Entry *eVoltageScale = new Entry(&voltageScale, &maxVolScale, &minVolScale,
			Font_Medium, 6, &Unit_Voltage, COLOR_DARKGREEN);
	Entry *eVoltageOffset = new Entry(&voltageOffset, &Limits.maxVoltage, &minVolOffset,
			Font_Medium, 6, &Unit_Voltage, COLOR_DARKGREEN);
	Entry *eTimebase = new Entry(&timebase, &maxTimebase, &minTimebase,
			Font_Medium, 6, &Unit_Time);
	eCurrentScale->setCallback(scopeChangeCurrent);
	eCurrentOffset->setCallback(scopeChangeCurrent);
	eVoltageScale->setCallback(scopeChangeVoltage);
	eVoltageOffset->setCallback(scopeChangeVoltage);

	Checkbox *cOn = new Checkbox(&running, onOffChange, COORDS(11,11));

	scope = new Scopescreen(COORDS(scopeWidth, 215), scopeHorDivs, 6);
	scope->AddLine(COLOR_RED, currentScale, currentOffset);
	scope->AddLine(COLOR_DARKGREEN, voltageScale, voltageOffset);

	c->attach(scope, COORDS(0, 0));
	c->attach(lScale, COORDS(0, 218));
	c->attach(eCurrentScale, COORDS(65, 216));
	c->attach(eVoltageScale, COORDS(115, 216));
	c->attach(lOffset, COORDS(0, 230));
	c->attach(eCurrentOffset, COORDS(65, 228));
	c->attach(eVoltageOffset, COORDS(115, 228));
	c->attach(lTimebase, COORDS(160, 230));
	c->attach(eTimebase, COORDS(235, 228));

	c->attach(lRunning, COORDS(160, 218));
	c->attach(cOn, COORDS(235, 216));

	/* Notify desktop of started app */
	desktop_AppStarted(Scope_Start, c);

	pushpull_SetCallback(pushpullCallback);

	while(1) {
		uint32_t signal;
		if (App_Handler(&signal, 300)) {
			/* Handle app signals */

		}
	}
}


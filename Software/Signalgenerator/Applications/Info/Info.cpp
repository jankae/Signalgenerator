#include "Info.h"
#include "gui.h"

#include "pushpull.h"
#include "desktop.h"
//#include "Battery/Battery.h"

static const uint16_t imagedata[1024] = {
		0x0000,0x0000,0x0000,0x0000,0x0000,0x0000,0x0000,0x0000,0x0000,0x0000,0x0000,0x0000,0x0000,0x0001,0x0043,0x0064,0x0064,0x0064,0x0022,0x0000,0x0000,0x0000,0x0000,0x0000,0x0000,0x0000,0x0000,0x0000,0x0000,0x0000,0x0000,0x0000,
		0x0000,0x0000,0x0000,0x0000,0x0000,0x0000,0x0000,0x0000,0x0000,0x0000,0x0042,0x00e9,0x01f1,0x12b5,0x2338,0x3bd9,0x3bd9,0x2b78,0x1ad6,0x0a53,0x014d,0x0085,0x0000,0x0000,0x0000,0x0000,0x0000,0x0000,0x0000,0x0000,0x0000,0x0000,
		0x0000,0x0000,0x0000,0x0000,0x0000,0x0000,0x0000,0x0000,0x0022,0x016c,0x2337,0x5c9c,0x8dbd,0xa61d,0xae5d,0xb67d,0xb67d,0xb65d,0xa63d,0x9dfd,0x6d1c,0x33da,0x0a11,0x0085,0x0000,0x0000,0x0000,0x0000,0x0000,0x0000,0x0000,0x0000,
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		0x0000,0x0000,0x0000,0x0000,0x0000,0x0000,0x0000,0x0000,0x0000,0x0000,0x0000,0x0000,0x0000,0x0000,0x0000,0x0000,0x0000,0x0000,0x0000,0x0000,0x0000,0x0000,0x0000,0x0000,0x0000,0x0000,0x0000,0x0000,0x0000,0x0000,0x0000,0x0000,
};

static Image_t icon = { .width = 32, .height = 32, .data = imagedata };

/* Forward declaration of actual app task */
static void Info(void *unused);

/* Creates the app task, called from desktop when user start the app */
static void Info_Start(){
	xTaskCreate(Info, "Info", 300, NULL, 3, NULL);
}

/* Register this app */
void Info_Init() {
	App_Register("Info", "View system state and information", Info_Start, icon);
}

static void Info(void *unused) {
	/* Create GUI elements */
	Container *c= new Container(COORDS(280, 240));
	c->setPosition(COORDS(40, 0));

	Label *lTemp = new Label("Temperature:", Font_Big);
	Label *lHeap = new Label("Free HEAP:", Font_Big);
	Label *lDiss = new Label("Int. Dissipat.:", Font_Big);

	int32_t heap;
	int32_t temp;
	int32_t dissipation;

	Entry *eTemp = new Entry(&temp, nullptr, nullptr, Font_Big, 6, &Unit_Temperature);
	Entry *eHeap = new Entry(&heap, nullptr, nullptr, Font_Big, 6, &Unit_Memory);
	Entry *eDiss = new Entry(&dissipation, nullptr, nullptr, Font_Big, 6, &Unit_Power);

	Label *lStackInfo = new Label("Task stacks:", Font_Big);
	Button *bStackInfo = new Button("View", Font_Big, [](Widget &w) {
						/* get Task status */
						TaskStatus_t *status;
						uint8_t numOfTasks;
						numOfTasks = uxTaskGetNumberOfTasks();
						status = new TaskStatus_t[numOfTasks];
						if (!status) {
							/* malloc failed */
							return;
						}
						/* read system status */
						uxTaskGetSystemState(status, numOfTasks, NULL);
						char *text = new char[16*numOfTasks];
						memset(text, ' ', 16*numOfTasks);
						for(uint8_t i=0;i<numOfTasks;i++) {
							uint8_t len = strlen(status[i].pcTaskName);
							if (len > 8)
								len = 8;
							memcpy(&text[i*16], status[i].pcTaskName, len);
							snprintf(&text[i*16+9], 6, "%*d", 5, status[i].usStackHighWaterMark);
							text[strlen(text)] = ' ';
							text[i*16+15] = '\n';
						}
						text[16*numOfTasks - 1] = 0;
						Dialog::MessageBox("Task Info", Font_Big, text, Dialog::MsgBox::OK, nullptr, false);

						delete text;
						delete status;
					});

	c->attach(lTemp, COORDS(5, 5));
	c->attach(eTemp, COORDS(200, 5));
	c->attach(lHeap, COORDS(5, 30));
	c->attach(eHeap, COORDS(200, 30));
	c->attach(lDiss, COORDS(5, 55));
	c->attach(eDiss, COORDS(200, 55));
	c->attach(lStackInfo, COORDS(5, 83));
	c->attach(bStackInfo, COORDS(200, 80));

	/* Notify desktop of started app */
	desktop_AppStarted(Info_Start, c);

	while(1) {

		heap = xPortGetFreeHeapSize();
		temp = pushpull_GetTemperature();

		/* calculate internal dissipation */
		// TODO instead of fixed 24V use measured 24V rail if adjustable rail is used
		if(pushpull_GetEnabled()) {
			/* Output is on, dissipation depends mainly on current */
			if(pushpull_GetCurrent()>0) {
				/* Sourcing current */
				dissipation = (int64_t) pushpull_GetCurrent()
						* (24000000 - pushpull_GetBatteryVoltage()) / 1000000;
			} else {
				/* Sinking current */
				dissipation = (int64_t) -pushpull_GetCurrent()
						* pushpull_GetBatteryVoltage() / 1000000;
			}
		} else {
			/* Output off */
			/* Dissipation is only the bias current */
			dissipation = pushpull_GetBiasCurrent() * (24000000/1000000);
		}

		eTemp->requestRedraw();
		eHeap->requestRedraw();
		eDiss->requestRedraw();

		uint32_t signal;
		if (App_Handler(&signal, 300)) {
			/* Handle app signals */
		}
	}
}
